## boards/arm/bitcraze_crazyradio_2/Kconfig
```kconfig
# Bitcraze Crazyradio 2.0 board configuration

# Copyright (c) 2022 Bitcraze AB
# Copyright (c) 2020 Nordic Semiconductor ASA
# SPDX-License-Identifier: Apache-2.0

if BOARD_BITCRAZE_CRAZYRADIO_2

config BOARD_ENABLE_DCDC
	bool "DCDC mode"
	select SOC_DCDC_NRF52X
	default y

config BOARD_HAS_NRF5_BOOTLOADER
	bool "Board has nRF5 bootloader"
	default n
	help
	  If selected, applications are linked so that they can be loaded by Nordic
	  nRF5 bootloader.

config BOARD_SERIAL_BACKEND_CDC_ACM
	bool "USB CDC"
	default y

endif # BOARD_BITCRAZE_CRAZYRADIO_2
```

## boards/arm/bitcraze_crazyradio_2/Kconfig.bitcraze_crazyradio_2
```kconfig
# Bitcraze Crazyradio 2.0 board configuration

# Copyright (c) 2022 Bitcraze AB
# Copyright (c) 2020 Nordic Semiconductor ASA
# SPDX-License-Identifier: Apache-2.0

config BOARD_BITCRAZE_CRAZYRADIO_2
	select SOC_NRF52840_QIAA
```

## boards/arm/bitcraze_crazyradio_2/Kconfig.pink_panda
```kconfig
# Pink Panda board configuration

config BOARD_PINK_PANDA
	select SOC_NRF52840_QIAA
```

## boards/arm/bitcraze_crazyradio_2/board.yml
```yaml
board:
  name: bitcraze_crazyradio_2
  full_name: Bitcraze Crazyradio 2
  vendor: bitcraze
  socs:
  - name: nrf52840
  revision:
    format: major.minor.patch
    default: "1.0.0"
    revisions:
    - name: "1.0.0"
```

## boards/arm/leak_detector/Kconfig
```kconfig
if BOARD_LEAK_DETECTOR

config BOARD_ENABLE_DCDC
	bool "DCDC mode"
	select SOC_DCDC_NRF52X
	default n

config BOARD_ENABLE_DCDC_HV
	bool "High Voltage DCDC converter"
	select SOC_DCDC_NRF52X_HV
	default n

config BOARD_HAS_NRF5_BOOTLOADER
	bool "Board has nRF5 bootloader"
	default n
	help
	  If selected, applications are linked so that they can be loaded by Nordic
	  nRF5 bootloader.

config BOARD_SERIAL_BACKEND_CDC_ACM
	bool "USB CDC"
	default n

endif # BOARD_LEAK_DETECTOR
```

## boards/arm/pink_panda/Kconfig.defconfig
```kconfig
# Pink Panda board configuration

if BOARD_PINK_PANDA

config HW_STACK_PROTECTION
	default ARCH_HAS_STACK_PROTECTION

config BOARD_REQUIRES_SERIAL_BACKEND_CDC_ACM
	default n

source "boards/common/usb/Kconfig.cdc_acm_serial.defconfig"

endif # BOARD_PINK_PANDA
```

## boards/arm/pink_panda/board.yml
```yaml
board:
  name: pink_panda
  full_name: Pink Panda
  vendor: gervais
  socs:
  - name: nrf52840
  revision:
    format: major.minor.patch
    default: "2.1.0"
    revisions:
    - name: "1.0.0"
    - name: "2.0.0"
    - name: "2.1.0"
```
